VERSION "SecurityLab CAN Basic Lab"

NS_ :

BS_:

BU_: ECU_TEST

BO_ 291 EngineData: 8 ECU_TEST
 SG_ EngineSpeed : 0|16@1+ (1,0) [0|65535] "rpm" ECU_TEST
 SG_ VehicleSpeed : 16|16@1+ (0.01,0) [0|655.35] "km/h" ECU_TEST

CM_ SG_ 291 EngineSpeed "Engine speed in revolutions per minute";
CM_ SG_ 291 VehicleSpeed "Vehicle speed in km/h";
